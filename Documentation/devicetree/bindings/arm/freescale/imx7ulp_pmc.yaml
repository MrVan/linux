## Documentation/devicetree/bindings/arm/freescale/imx7ulp_pmc.yaml
```yaml
# SPDX-License-Identifier: GPL-2.0
%YAML 1.2
---
$id: http://devicetree.org/schemas/arm/al,alpine.yaml#
$schema: http://devicetree.org/meta-schemas/core.yaml#

title: i.MX7ULP Power Management Controller(PMC) Device Tree Bindings

maintainers:
  - Peng Fan <peng.fan@nxp.com>

properties:
  compatible:
    items:
      - enum:
          - fsl,imx7ulp-pmc0
          - fsl,imx7ulp-pmc1

  reg:
    maxItems: 1

required:
  - compatible
  - reg

examples:
  - |
    pmc0: pmc0@410a1000 {
        compatible = "fsl,imx7ulp-pmc0";
        reg = <0x410a1000 0x1000>;
    };
...
```
